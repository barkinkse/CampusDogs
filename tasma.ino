#include <Wire.h>
#include <Adafruit_GFX.h>
#include <Adafruit_SSD1306.h>
#include <BLEDevice.h>
#include <BLEServer.h>
#include <BLEUtils.h>
#include <BLEAdvertising.h>
#include <Preferences.h>

#define SCREEN_WIDTH 128
#define SCREEN_HEIGHT 64
#define OLED_RESET -1
#define DOG_ID "DOG-001"
#define DEVICE_NAME "Boncuk"
#define SERVICE_UUID "9f8c1000-6d2b-4baf-9e81-62f4d09c0001"
#define STATUS_UUID "9f8c1001-6d2b-4baf-9e81-62f4d09c0001"

Adafruit_SSD1306 display(SCREEN_WIDTH, SCREEN_HEIGHT, &Wire, OLED_RESET);
Preferences preferences;
bool awaitingSync = true;  // Reboot sonrası kayit, henüz BLE ile dogrulanmadi
BLEServer* bleServer = nullptr;
BLECharacteristic* statusCharacteristic = nullptr;
volatile uint8_t pendingStatus = 0;
volatile bool statusReceived = false;
uint8_t currentStatus = 0;
int8_t currentScreen = -1;
unsigned long lastScreenChange = 0;

// Priority order: healing, special diet, running, vision, hearing, checkup.
const uint8_t statusBits[6] = {1, 4, 2, 8, 16, 32};
const char* statusNames[6] = {
  "IYILESME SURECI", "OZEL BESLENME", "KOSMAYI SINIRLA",
  "GORME HASSASIYETI", "ISITME HASSASIYETI", "DUZENLI KONTROL"
};

// 32x32 monochrome icons, generated as PROGMEM bitmaps.
const uint8_t PROGMEM icon0[128] = {
  0x00, 0x00, 0x00, 0x00, 0x00, 0x00, 0x00, 0x00, 0x00, 0x00, 0x00, 0x00, 0x00, 0x00, 0x30, 0x00,
  0x00, 0x00, 0x78, 0x00, 0x00, 0x00, 0xFC, 0x00, 0x00, 0x01, 0xCE, 0x00, 0x00, 0x03, 0xB7, 0x00,
  0x00, 0x07, 0x33, 0x80, 0x00, 0x0E, 0x01, 0xC0, 0x00, 0x1F, 0x00, 0xE0, 0x00, 0x3F, 0x83, 0x70,
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  0x00, 0x0C, 0x00, 0x00, 0x00, 0x00, 0x00, 0x00, 0x00, 0x00, 0x00, 0x00, 0x00, 0x00, 0x00, 0x00
};
const uint8_t PROGMEM icon1[128] = {
  0x00, 0x00, 0x00, 0x00, 0x00, 0x00, 0x00, 0x00, 0x00, 0x00, 0x00, 0x00, 0x00, 0x00, 0x00, 0x10,
  0x00, 0x00, 0x00, 0x38, 0x00, 0x00, 0x00, 0x7C, 0x00, 0x00, 0x00, 0xF8, 0x00, 0x00, 0x01, 0xF0,
  0x00, 0x00, 0x03, 0xE0, 0x00, 0x00, 0x07, 0xC0, 0x00, 0x00, 0x0F, 0x80, 0x00, 0x00, 0x1F, 0x00,
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  0x0E, 0x07, 0xF0, 0x00, 0x04, 0x00, 0x00, 0x00, 0x00, 0x00, 0x00, 0x00, 0x00, 0x00, 0x00, 0x00
};
const uint8_t PROGMEM icon2[128] = {
  0x00, 0x00, 0x00, 0x00, 0x00, 0x00, 0x00, 0x00, 0x00, 0x1F, 0xF0, 0x00, 0x00, 0x7F, 0xFC, 0x00,
  0x00, 0xF0, 0x1E, 0x60, 0x03, 0xC0, 0xC7, 0xF0, 0x07, 0x01, 0xE1, 0xF0, 0x06, 0x01, 0xE3, 0xE0,
  0x0C, 0x00, 0xC7, 0xE0, 0x1C, 0x00, 0x8F, 0xF0, 0x18, 0x00, 0xDF, 0x30, 0x38, 0x01, 0xBE, 0x38,
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  0x00, 0x1F, 0xF0, 0x00, 0x00, 0x00, 0x00, 0x00, 0x00, 0x00, 0x00, 0x00, 0x00, 0x00, 0x00, 0x00
};
const uint8_t PROGMEM icon3[128] = {
  0x00, 0x00, 0x00, 0x00, 0x00, 0x00, 0x00, 0x00, 0x00, 0x00, 0x00, 0x00, 0x00, 0x00, 0x00, 0x00,
  0x00, 0x00, 0x00, 0x00, 0x00, 0x00, 0x00, 0x20, 0x00, 0x00, 0x00, 0x70, 0x00, 0x00, 0x00, 0xE0,
  0x00, 0x00, 0x01, 0xC0, 0x00, 0x3F, 0xFF, 0x80, 0x00, 0x41, 0xC7, 0x00, 0x00, 0x87, 0xFE, 0x80,
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  0x04, 0x00, 0x00, 0x00, 0x00, 0x00, 0x00, 0x00, 0x00, 0x00, 0x00, 0x00, 0x00, 0x00, 0x00, 0x00
};
const uint8_t PROGMEM icon4[128] = {
  0x00, 0x00, 0x00, 0x00, 0x00, 0x00, 0x00, 0x00, 0x00, 0x0F, 0xE0, 0x00, 0x00, 0x3F, 0xF8, 0x00,
  0x00, 0xF8, 0x3E, 0x00, 0x01, 0xE0, 0x0F, 0x00, 0x01, 0x83, 0x83, 0x80, 0x03, 0x1F, 0xF1, 0x80,
  0x07, 0x1E, 0xF8, 0xC0, 0x06, 0x30, 0x18, 0xE0, 0x0E, 0x71, 0x8C, 0xE0, 0x0E, 0x63, 0xEC, 0x60,
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  0x00, 0x1F, 0xC0, 0x00, 0x00, 0x07, 0x00, 0x00, 0x00, 0x00, 0x00, 0x00, 0x00, 0x00, 0x00, 0x00
};
const uint8_t PROGMEM icon5[128] = {
  0x00, 0x00, 0x00, 0x00, 0x00, 0x00, 0x00, 0x00, 0x00, 0x00, 0x00, 0x00, 0x00, 0x00, 0x00, 0x00,
  0x00, 0x00, 0x00, 0x00, 0x00, 0x40, 0x01, 0x00, 0x00, 0xB0, 0x06, 0x80, 0x03, 0x08, 0x08, 0x60,
  0x04, 0x04, 0x10, 0x10, 0x08, 0x03, 0x60, 0x08, 0x08, 0x00, 0x80, 0x08, 0x08, 0x03, 0xE0, 0x08,
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  0x00, 0x01, 0x40, 0x00, 0x00, 0x00, 0x80, 0x00, 0x00, 0x00, 0x00, 0x00, 0x00, 0x00, 0x00, 0x00
};

const uint8_t* const icons[6] = {icon0, icon1, icon2, icon3, icon4, icon5};

int activeCount() {
  int count = 0;
  for (int i = 0; i < 6; ++i) if (currentStatus & statusBits[i]) ++count;
  return count;
}

int firstActive() {
  for (int i = 0; i < 6; ++i) if (currentStatus & statusBits[i]) return i;
  return -1;
}

int nextActive(int after) {
  for (int step = 1; step <= 6; ++step) {
    int i = (after + step) % 6;
    if (currentStatus & statusBits[i]) return i;
  }
  return -1;
}

void centeredText(const char* text, int16_t y) {
  int16_t x1, y1;
  uint16_t w, h;
  display.getTextBounds(text, 0, y, &x1, &y1, &w, &h);
  display.setCursor((SCREEN_WIDTH - (int)w) / 2, y);
  display.print(text);
}

void updateOLED() {
  display.clearDisplay();
  display.setTextColor(SSD1306_WHITE);
  display.setTextSize(1);
  display.setTextWrap(false);
  display.setCursor(0, 0);
  display.print("PAWLINK");
  display.setCursor(86, 0);
  display.print(DOG_ID);
  // * : hafizadan yuklenen, henuz bu acilista dogrulanmamis veri
  if (awaitingSync) display.drawChar(77, 0, '*', SSD1306_WHITE, SSD1306_BLACK, 1);
  display.drawFastHLine(0, 10, 128, SSD1306_WHITE);

  if (currentStatus == 0 || currentScreen < 0) {
    display.setTextSize(2);
    centeredText("NORMAL", 20);
    display.setTextSize(1);
    centeredText("OZEL DURUM YOK", 45);
  } else {
    display.drawBitmap(48, 12, icons[currentScreen], 32, 32, SSD1306_WHITE);
    centeredText(statusNames[currentScreen], 45);
    int count = activeCount();
    if (count > 1) {
      int rank = 0;
      for (int i = 0; i < 6; ++i) {
        if (currentStatus & statusBits[i]) {
          if (i == currentScreen) break;
          ++rank;
        }
      }
      int totalWidth = count * 9 - 3;
      int startX = (128 - totalWidth) / 2;
      for (int j = 0; j < count; ++j) {
        int x = startX + j * 9;
        if (j == rank) display.fillRoundRect(x, 58, 6, 4, 2, SSD1306_WHITE);
        else display.drawRoundRect(x, 58, 6, 4, 2, SSD1306_WHITE);
      }
    }
  }
  display.display();
}

class StatusCallbacks : public BLECharacteristicCallbacks {
  void onWrite(BLECharacteristic* characteristic) override {
    String value = characteristic->getValue();
    if (value.length() == 1) {
      uint8_t incoming = (uint8_t)value[0];
      if (incoming <= 63) {
        pendingStatus = incoming;
        statusReceived = true;
      }
    }
  }
};

class ServerCallbacks : public BLEServerCallbacks {
  void onDisconnect(BLEServer* server) override {
    BLEDevice::startAdvertising();
  }
};

void setup() {
  Serial.begin(115200);
  delay(1000);
  Wire.begin(21, 22);
  if (!display.begin(SSD1306_SWITCHCAPVCC, 0x3C)) {
    Serial.println("OLED HATASI!");
    while (true) delay(1000);
  }
  preferences.begin("pawlink", false);
  currentStatus = preferences.getUChar("status", 0);
  if (currentStatus > 63) currentStatus = 0;
  currentScreen = firstActive();
  lastScreenChange = millis();
  Serial.print("KAYITLI DURUM: ");
  Serial.println(currentStatus);
  updateOLED();

  BLEDevice::init(DEVICE_NAME);
  bleServer = BLEDevice::createServer();
  bleServer->setCallbacks(new ServerCallbacks());
  BLEService* service = bleServer->createService(SERVICE_UUID);
  statusCharacteristic = service->createCharacteristic(
    STATUS_UUID, BLECharacteristic::PROPERTY_WRITE
  );
  statusCharacteristic->setCallbacks(new StatusCallbacks());
  service->start();

  BLEAdvertisementData advData;
  advData.setFlags(0x06);
  // iPhone uygulamasinin gorecegi BLE reklam adi.
  advData.setName(DEVICE_NAME);
  String manufacturerData;
  manufacturerData += (char)0xFF;
  manufacturerData += (char)0xFF;
  manufacturerData += DOG_ID;
  advData.setManufacturerData(manufacturerData);
  BLEAdvertising* advertising = BLEDevice::getAdvertising();
  advertising->setAdvertisementData(advData);
  advertising->start();
  Serial.print("BLE REKLAM ADI: ");
  Serial.println(DEVICE_NAME);
  Serial.println("PAWLINK COLLAR V4 READY");
}

void loop() {
  if (statusReceived) {
    uint8_t newStatus = pendingStatus;
    statusReceived = false;
    Serial.print("BLE DURUM ALINDI: ");
    Serial.println(newStatus);

    bool statusChanged = (newStatus != currentStatus);
    bool wasAwaitingSync = awaitingSync;
    awaitingSync = false;

    if (statusChanged) {
      currentStatus = newStatus;
      currentScreen = firstActive();
      lastScreenChange = millis();
      preferences.putUChar("status", currentStatus);
      Serial.println("DURUM NVS BELLEGE KAYDEDILDI");
    }

    // Ayni durum tekrar geldiginde ikon dongusu sifirlanmaz.
    if (statusChanged || wasAwaitingSync) updateOLED();
  }

  if (currentStatus != 0 && activeCount() > 1) {
    unsigned long duration = (currentScreen == firstActive()) ? 8000UL : 4000UL;
    if (millis() - lastScreenChange >= duration) {
      currentScreen = nextActive(currentScreen);
      lastScreenChange = millis();
      updateOLED();
    }
  }
  delay(20);
}
